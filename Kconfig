## Kconfig
```kconfig
#
# my device configuration
#

menu "My devices drivers support"


config MYDRIVERS
	tristate "support all my drivers for exercise!"
	default n
	help
	  Say Y to compile my driver.
	  Say N not to compile.

	  To compile this drivers as a module, choose M here: the
	  module will be dynamically loaded into kernel.

if MYDRIVERS

config EX01DRV
	tristate "first driver"
	default n
	help
	  Say Y enable first driver compile into kernel.

	  To compile this driver as a module, choose M here: the
	  module will be dynamically loaded into kernel.



source "drivers/mydrivers/ex01_drv/Kconfig"


config EX02DRV
	tristate "second driver"
	default n
	help
	  Say Y enable first driver compile into kernel.

	  To compile this driver as a module, choose M here: the
	  module will be dynamically loaded into kernel.



source "drivers/mydrivers/ex02_drv/Kconfig"

endif

endmenu
```

## ex01_drv/Kconfig
```kconfig
#
# My first drivers for study
#

menu "first Devices"

config EX01DRV
	tristate "support first driver test"
	default n
	---help---
	This option enables study test first driver.

endmenu
```

## ex02_drv/Kconfig
```kconfig
#
# My first drivers for study
#

menu "second Devices"

config EX02DRV
	tristate "support second driver test"
	default n
	---help---
	This option enables study test second driver.

endmenu
```
